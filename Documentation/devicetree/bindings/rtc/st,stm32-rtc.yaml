## Documentation/devicetree/bindings/rtc/st,stm32-rtc.yaml
```yaml
# SPDX-License-Identifier: (GPL-2.0-only OR BSD-2-Clause)
%YAML 1.2
---
$id: http://devicetree.org/schemas/rtc/st,stm32-rtc.yaml#
$schema: http://devicetree.org/meta-schemas/core.yaml#

title: STMicroelectronics STM32 Real Time Clock

maintainers:
  - Gabriel Fernandez <gabriel.fernandez@foss.st.com>

properties:
  compatible:
    enum:
      - st,stm32mp1-rtc
      - st,stm32mp25-rtc

  reg:
    maxItems: 1

  clocks:
    minItems: 1
    maxItems: 2

  clock-names:
    items:
      - const: pclk
      - const: rtc_ck

  interrupts:
    maxItems: 1

  st,syscfg:
    $ref: /schemas/types.yaml#/definitions/phandle-array
    items:
      minItems: 3
      maxItems: 3
    description: |
      Phandle/offset/mask triplet. The phandle to pwrcfg used to
      access control register at offset, and change the dbp (Disable Backup
      Protection) bit represented by the mask, mandatory to disable/enable backup
      domain (RTC registers) write protection.

  assigned-clocks:
    description: |
      override default rtc_ck parent clock reference to the rtc_ck clock entry
    maxItems: 1

  assigned-clock-parents:
    description: |
      override default rtc_ck parent clock phandle of the new parent clock of rtc_ck
    maxItems: 1

patternProperties:
  "^rtc-[a-z]+-[0-9]+$":
    type: object
    $ref: /schemas/pinctrl/pinmux-node.yaml
    description: |
      Configuration of STM32 RTC pins description. STM32 RTC is able to output
      some signals on specific pins:
      - LSCO (Low Speed Clock Output) that allow to output LSE clock on a pin.
      - Alarm out that allow to send a pulse on a pin when alarm A of the RTC
        expires.
    additionalProperties: false
    properties:
      function:
        enum:
          - lsco
          - alarm-a
      pins:
        enum:
          - out1
          - out2
          - out2_rmp

allOf:
  - if:
      properties:
        compatible:
          contains:
            enum:
              - st,stm32mp1-rtc
              - st,stm32mp25-rtc

    then:
      properties:
        clocks:
          minItems: 2
          maxItems: 2

        assigned-clocks: false
        assigned-clock-parents: false

      required:
        - clock-names

required:
  - compatible
  - reg
  - clocks
  - interrupts

additionalProperties: false

examples:
  - |
    #include <dt-bindings/interrupt-controller/arm-gic.h>
    #include <dt-bindings/clock/stm32mp1-clks.h>
    rtc@5c004000 {
      compatible = "st,stm32mp1-rtc";
      reg = <0x5c004000 0x400>;
      clocks = <&rcc RTCAPB>, <&rcc RTC>;
      clock-names = "pclk", "rtc_ck";
      interrupts = <GIC_SPI 3 IRQ_TYPE_LEVEL_HIGH>;
    };

...
```

## drivers/mtd/spi-nor/controllers/Kconfig
```kconfig
# SPDX-License-Identifier: GPL-2.0-only
config SPI_HISI_SFC
	tristate "Hisilicon FMC SPI NOR Flash Controller(SFC)"
	depends on ARCH_HISI || COMPILE_TEST
	depends on HAS_IOMEM
	help
	  This enables support for HiSilicon FMC SPI NOR flash controller.
```

## drivers/net/wireless/st/cw1200/Kconfig
```kconfig
# SPDX-License-Identifier: GPL-2.0-only
config CW1200
	tristate "CW1200 WLAN support"
	depends on MAC80211 && CFG80211
	depends on MMC
	help
	  This is a driver for the ST-E CW1100 & CW1200 WLAN chipsets.
	  This option just enables the driver core, see below for
	  specific bus support.
```

## drivers/pinctrl/stm32/Kconfig
```kconfig
# SPDX-License-Identifier: GPL-2.0-only
if ARCH_STM32 || COMPILE_TEST

config PINCTRL_STM32
	tristate
	depends on OF
	select PINMUX
	select GENERIC_PINCONF
	select GPIOLIB
	select IRQ_DOMAIN_HIERARCHY
	select MFD_SYSCON

config PINCTRL_STM32MP135
	bool "STMicroelectronics STM32MP135 pin control" if COMPILE_TEST && !MACH_STM32MP13
	depends on OF && HAS_IOMEM
	default MACH_STM32MP13
	select PINCTRL_STM32

config PINCTRL_STM32MP157
	bool "STMicroelectronics STM32MP157 pin control" if COMPILE_TEST && !MACH_STM32MP157
	depends on OF && HAS_IOMEM
	default MACH_STM32MP157
	select PINCTRL_STM32

config PINCTRL_STM32MP257
	tristate "STMicroelectronics STM32MP257 pin control"
	depends on OF && HAS_IOMEM
	default MACH_STM32MP25 || (ARCH_STM32 && ARM64)
	select PINCTRL_STM32

config PINCTRL_STM32_HDP
	tristate "STMicroelectronics STM32 Hardware Debug Port (HDP) pin control"
	depends on OF && HAS_IOMEM
	default ARCH_STM32
	select PINMUX
	select GENERIC_PINCONF
	select GPIOLIB
	select GPIO_GENERIC
	help
	  The Hardware Debug Port allows the observation of internal signals.
	  It uses configurable multiplexer to route signals in a dedicated observation register.
	  This driver also permits the observation of signals on external SoC pins.
	  It permits the observation of up to 16 signals per HDP line.

endif
```
